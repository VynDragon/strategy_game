## Kconfig
```kconfig
config DATA_PATH
	string "Path to data folder"
	default "data"

config TEASER_SCENES
	bool "Teaser Scenes"

rsource "lib/Kconfig"
```

## lib/Kconfig
```kconfig
config STRATEGY_UI
	bool "Strategy Game UI"

config STRATEGY_GAME
	bool "Strategy Game arching code"

if STRATEGY_UI

config DEFAULT_UI
	default n

endif
```

## west.yml
```yaml
manifest:
  remotes:
    - name: zephyrproject-rtos
      url-base: https://github.com/zephyrproject-rtos
    - name: VynDragon
      url-base: https://github.com/VynDragon

  projects:
    - name: zephyr_3d_game_template2
      remote: VynDragon
      revision: main
      import: false
    - name: zephyr
      remote: zephyrproject-rtos
      revision: main
      import:
        name-allowlist:
          - hal_bouffalolab
          - lvgl
          - cmsis
          - hal_rpi_pico
          - cmsis_6
          - hal_espressif
          - hal_st
          - hal_stm32
```
